## contrib/board/vd-rd/glasnost_9g10/glasnost_9g10sd_uboot_defconfig
```kconfig
CONFIG_GLASNOST_9G10=y
CONFIG_CPU_CLK_266MHZ=y
CONFIG_SDCARD=y
CONFIG_AT91_MCI=y
CONFIG_AT91_MCI0=y
CONFIG_MCI_SLOTA=y
CONFIG_THUMB=y
CONFIG_RAM_64MB=y
CONFIG_WDT=y
```

## contrib/board/vd-rd/glasnostmk3/glasnostmk3_uboot_defconfig
```kconfig
CONFIG_GLASNOSTMK3=y
CONFIG_CPU_CLK_266MHZ=y
CONFIG_SDCARD=y
CONFIG_DEBUG=y
CONFIG_THUMB=y
```
