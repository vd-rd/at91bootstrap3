## contrib/board/vd-rd/glasnost_9g20/glasnost_9g20sd_uboot_defconfig
```kconfig
CONFIG_GLASNOST_9G20=y
CONFIG_SDCARD=y
#double check
CONFIG_MCI_SLOTA=y

CONFIG_RAM_64MB=y
CONFIG_DEBUG=y
CONFIG_THUMB=y
```
